## ESPLIB/sdkconfig.defaults.esp32p4
```kconfig
CONFIG_SPIRAM=y
CONFIG_SPIRAM_MODE_HEX=y
CONFIG_SPIRAM_SPEED_200M=y
CONFIG_SPIRAM_ALLOW_BSS_SEG_EXTERNAL_MEMORY=y
CONFIG_IDF_EXPERIMENTAL_FEATURES=y

# very specific to stamp
CONFIG_ESP_HOSTED_SPI_HOST_INTERFACE=y
CONFIG_ESP_HOSTED_SPI_HSPI_GPIO_MOSI=54
CONFIG_ESP_HOSTED_SPI_HSPI_GPIO_MISO=53
CONFIG_ESP_HOSTED_SPI_HSPI_GPIO_CLK=50
CONFIG_ESP_HOSTED_SPI_HSPI_GPIO_CS=20
CONFIG_ESP_HOSTED_SPI_GPIO_HANDSHAKE=51
CONFIG_ESP_HOSTED_SPI_GPIO_DATA_READY=23
CONFIG_ESP_HOSTED_SPI_GPIO_RESET_SLAVE=52
```
